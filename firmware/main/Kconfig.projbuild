## firmware/main/Kconfig.projbuild
```kconfig
menu "Quellog Firmware"

config QUELLOG_BOARD_TYPE_ZECTRIX_S3_EPAPER_4_2
    bool "zectrix-s3-epaper-4.2"
    default y
    depends on IDF_TARGET_ESP32S3
    help
        Default Quellog development board.

config QUELLOG_BUTTON_UP_GPIO
    int "UP button GPIO"
    default 39
    range -1 48
    depends on QUELLOG_BOARD_TYPE_ZECTRIX_S3_EPAPER_4_2

config QUELLOG_BUTTON_DOWN_GPIO
    int "DOWN button GPIO"
    default 18
    range -1 48
    depends on QUELLOG_BOARD_TYPE_ZECTRIX_S3_EPAPER_4_2

config QUELLOG_BUTTON_CONFIRM_GPIO
    int "CONFIRM button GPIO"
    default 0
    range -1 48
    depends on QUELLOG_BOARD_TYPE_ZECTRIX_S3_EPAPER_4_2

config QUELLOG_INPUT_DEBOUNCE_MS
    int "Button debounce in milliseconds"
    default 180
    range 50 1000

config QUELLOG_AUTO_REFRESH_SECONDS
    int "Timed refresh interval in seconds"
    default 30
    range 5 3600

endmenu
```

## firmware/sdkconfig.defaults
```kconfig
CONFIG_COMPILER_CXX_EXCEPTIONS=y
CONFIG_COMPILER_CXX_RTTI=y
CONFIG_BOOTLOADER_LOG_LEVEL_INFO=y
CONFIG_ESP_MAIN_TASK_STACK_SIZE=8192
CONFIG_ESP_SYSTEM_EVENT_TASK_STACK_SIZE=4096
CONFIG_ESPTOOLPY_FLASHSIZE_16MB=y
CONFIG_ESPTOOLPY_FLASHMODE_QIO=y
CONFIG_ESP_DEFAULT_CPU_FREQ_MHZ_240=y
CONFIG_PARTITION_TABLE_SINGLE_APP=y
CONFIG_PARTITION_TABLE_OFFSET=0x8000
CONFIG_FREERTOS_HZ=1000
```
